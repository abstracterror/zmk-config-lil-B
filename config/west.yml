## config/west.yml
```yaml
manifest:
  remotes:
    - name: zmkfirmware
      url-base: https://github.com/zmkfirmware
    - name: kilipan
      url-base: https://github.com/kilipan
    - name: urob
      url-base: https://github.com/urob
  projects:
    - name: zmk
      remote: urob
      revision: v0.2+fix-child-nodes
      import: app/west.yml
    - name: zmk-keyboards-lil-B
      remote: kilipan
      revision: main
    - name: zmk-leader-key
      remote: urob
      revision: v0.2
  self:
    path: config
```
